## examples/riot/examples_libcoap_client/Kconfig
```kconfig
if USEMODULE_LIBCOAP
config LIBCOAP_CLIENT_URI
    string "CoAP URI to connect to"
    default "coap://[fe80::405:5aff:fe15:9b7f]/.well-known/core"
config LIBCOAP_USE_PSK
    string "Secret to use for PSK communications"
    default "secretPSK"
    depends on USEMODULE_TINYDTLS
config LIBCOAP_USE_PSK_ID
    string "User ID to use for PSK communications"
    default "user_abc"
    depends on USEMODULE_TINYDTLS
config LIBCOAP_SERVER_SUPPORT
    bool "Set to y if server support is required"
    default n
config LIBCOAP_CLIENT_SUPPORT
    bool "Set to y if client support is required"
    default y
endif # USEMODULE_LIBCOAP
```

## examples/riot/examples_libcoap_server/Kconfig
```kconfig
if USEMODULE_LIBCOAP
config LIBCOAP_USE_PSK
    string "Secret to use for PSK communications"
    default "secretPSK"
    depends on USEMODULE_TINYDTLS
config LIBCOAP_SERVER_SUPPORT
    bool "Set to y if server support is required"
    default y
config LIBCOAP_CLIENT_SUPPORT
    bool "Set to y if ongoing proxy support is required"
    default n
endif # USEMODULE_LIBCOAP
```
