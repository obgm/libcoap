## CMakeLists.txt
```
# SPDX-License-Identifier: Apache-2.0

cmake_minimum_required(VERSION 3.20.0)
find_package(Zephyr REQUIRED HINTS $ENV{ZEPHYR_BASE})
project(coap_client)

target_sources(app PRIVATE src/test.cpp)

include(${ZEPHYR_BASE}/samples/net/common/common.cmake)
```

## Kconfig
```
# Private config options for coap-client sample app

# Copyright (c) 2020 Intel Corporation
# SPDX-License-Identifier: Apache-2.0

mainmenu "Test cpp build application"

source "Kconfig.zephyr"
```

## prj.conf
```kconfig
CONFIG_LOG=y

CONFIG_LIBCOAP=y
```

## src/test.cpp
```c
#include <zephyr/logging/log.h>
LOG_MODULE_REGISTER(coap_cpp_test, LOG_LEVEL_DBG);

#include <zephyr/kernel.h>
#include <errno.h>
#include "coap3/coap.h"
#include <stdio.h>

coap_str_const_t *xxx_libcoap_get_version() {
  coap_str_const_t *ver;

  ver = coap_make_str_const(LIBCOAP_PACKAGE_VERSION);
  printf("Version: %s\n", ver->s);
  return ver;
}

int main()
{
  xxx_libcoap_get_version();
  return 0;
}
```
